#if 0
#include <SPI.h>
#define PIN_CS    5
#define PIN_SCK   18
#define PIN_MOSI  23
#define PIN_MISO  19

//#define PW_PIN    4
//#define RST_PIN   15
#define    REGS_PIN  15
#define    RSTB_PIN  16
#define  PIN_MAX   5

#define  RSTB_OP(val) digitalWrite(RSTB_PIN,val)
#define  RS_OP(val)   digitalWrite(REGS_PIN,val) 
#define  CS_OP(val)   digitalWrite(PIN_CS,val) 

#define SPI_SPEED 2000000

typedef unsigned char uint8;

void lcd_reset()
{
  RSTB_OP(0);
  delay(2);
  RSTB_OP(1);
  delay(4);
}

void send_lcd_command(uint8 cmd)
{
    //digitalWrite(RST_PIN,0);
    //digitalWrite(PIN_CS,0);
    RS_OP(0);
    CS_OP(0);
    SPI.transfer(cmd);
}


void send_lcd_data(uint8 data)
{   
  uint8 bit8;
  RS_OP(1);
  CS_OP(0);
  SPI.transfer(data);
}


void clear_screen(uint8 xx)
{
  uint8 i,j;
  for(i=0;i<9;i++)
  {
      CS_OP(0);
      send_lcd_command(0xb0+i);
      send_lcd_command(0x10);
      send_lcd_command(0x00);
      for(j=0;j<132;j++)
      {
        send_lcd_data(xx);
      }
  }
}


void init_lcd()
{
    lcd_reset();
    delay(100);
    send_lcd_command(0xe2);     //systen reset

    send_lcd_command(0x2c);    //set power control 
    send_lcd_command(0x2e);    //set power control 
    send_lcd_command(0x2f);    //set power control 
         
    send_lcd_command(0x25);    //set vlcd registor radio

    send_lcd_command(0x81);     //
    send_lcd_command(0x1a);

    send_lcd_command(0xa2);
         
    send_lcd_command(0xc8);    //MY=1

    send_lcd_command(0xa0);     // MX=0

    send_lcd_command(0xaf);     //
}

int pin_list[PIN_MAX]={5,15,16,18,23};

void setup() {
  // put your setup code here, to run once:
    for(int i = 0 ; i < PIN_MAX; i++)
    {
      pinMode(pin_list[i],OUTPUT);
    }

    SPI.beginTransaction(SPISettings(SPI_SPEED, MSBFIRST, SPI_MODE0));
    init_lcd();
    //clear_screen(0xff);
}

void loop() {
  // put your main code here, to run repeatedly:
  clear_screen(0xff);
  clear_screen(0);

}
#else

   
//**************************************UC1701 96*49 DOTS *************************

#define unchar  unsigned char
#define unint   unsigned int 
//--------------------------------------------------------- 4线SPI接口 驱动
                                      
#define    RSTB_PIN  16
#define    SDI_PIN   23
#define    SCL_PIN   18
#define    CS_PIN    5
#define    REGS_PIN  15

#define  CS_OP(val)   digitalWrite(CS_PIN,val) 
#define  RS_OP(val)   digitalWrite(REGS_PIN,val) 
#define  SCL_OP(val)  digitalWrite(SCL_PIN,val) 
#define  SDI_OP(val)  digitalWrite(SDI_PIN,val) 
#define  RSTB_OP(val) digitalWrite(RSTB_PIN,val)

unchar graphic1[]=
{
0x80,0xF0,0x10,0x10,0xD0,0x40,0x60,0x20,0x20,0x20,0x80,0xC0,0xC0,0x40,0xC0,0xE0,
0xF0,0xF8,0xFE,0x9F,0xCD,0xF5,0xE1,0xF0,0xF8,0xF8,0xFC,0xF4,0xF0,0xF0,0xF8,0xD8,
0xC8,0x40,0x00,0x00,0x00,0x00,0x00,0x80,0x00,0xC0,0xE0,0xF8,0xF0,0xF8,0xFC,0xFE,
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0x7F,0x7F,0x0E,0x1B,0x31,0x60,0x40,0x00,0x00,0x00,0x00,0x00,0x00,0x00,0x00,0x00,
};

void Init_S6B33B();
void Write_S6B33B_COM(unchar COMDADA_4SPI);
void Write_S6B33B_DISPLAY_DATA_serial_4SPI(unchar DADA_4SPI);
void Delay_ms(unsigned long value);
void HDReset();
void Keypress(void);
void clear_screen(unchar xx);
void Display_pic1();
void Display_fangkuang();

void run_lcd()
{ 

   clear_screen(0xff);
  Delay_ms(1000);
   clear_screen(0x55);
  Delay_ms(1000);
   clear_screen(0xaa);
  Delay_ms(1000);
   clear_screen(0x00);
   Display_fangkuang();
   Delay_ms(1000);
   clear_screen(0x00);
   Display_pic1();
}

//--------------------------------------------------------------------------

void Init_S6B33B()
{
  HDReset();
  Delay_ms(100);

       Write_S6B33B_COM(0xe2);     //systen reset

       Write_S6B33B_COM(0x2c);    //set power control 
       Write_S6B33B_COM(0x2e);    //set power control 
       Write_S6B33B_COM(0x2f);    //set power control 
         
       Write_S6B33B_COM(0x25);    //set vlcd registor radio

       Write_S6B33B_COM(0x81);     //
       Write_S6B33B_COM(0x1a);

       Write_S6B33B_COM(0xa2);
         
       Write_S6B33B_COM(0xc8);    //MY=1

       Write_S6B33B_COM(0xa0);     // MX=0

       Write_S6B33B_COM(0xaf);     //


}


void clear_screen(unchar xx)
{
unchar i,j;
for(i=0;i<9;i++)
  {
    CS_OP(0);
    Write_S6B33B_COM(0xb0+i);
      Write_S6B33B_COM(0x10);
    Write_S6B33B_COM(0x00);
    for(j=0;j<132;j++)
    {
      Write_S6B33B_DISPLAY_DATA_serial_4SPI(xx);
    }
   }
}
unsigned char show_a[]=  { 0x30,0x70,0x40,0x41,0x7f,0x3f,0x01,0x00 } ; // 41 A

void Display_pic1()
{
  unint i,j,adressd=0;

  for(i=0;i<6;i++)
  {
    CS_OP(0);
    Write_S6B33B_COM(0xb0+i);
      Write_S6B33B_COM(0x10);
    Write_S6B33B_COM(0x00);
    for(j=0;j<96;j++)
    {
      Write_S6B33B_DISPLAY_DATA_serial_4SPI(graphic1[adressd]);
      adressd++;
    }
  }
} 

void display_char()
{
    unint i=0,j;
    
  for(i=0;i<5;i++)
  {
    CS_OP(0);
    Write_S6B33B_COM(0xb0+i);
    Write_S6B33B_COM(0x10);
    Write_S6B33B_COM(0x00);
    for(j=0;j<sizeof(show_a);j++)
    {
      Write_S6B33B_DISPLAY_DATA_serial_4SPI(show_a[j]);
    }
  }
}

void Display_fangkuang()
{
  unint i,j;
  for(i=0;i<5;i++)
  {
    CS_OP(0);
    Write_S6B33B_COM(0xb0+i);
      Write_S6B33B_COM(0x10);
    Write_S6B33B_COM(0x00);
    Write_S6B33B_DISPLAY_DATA_serial_4SPI(0xff);
    for(j=0;j<94;j++)
    {
      Write_S6B33B_DISPLAY_DATA_serial_4SPI(0x00);
    }
    Write_S6B33B_DISPLAY_DATA_serial_4SPI(0xff);
   }

    CS_OP(0);
    Write_S6B33B_COM(0xb5);
      Write_S6B33B_COM(0x10);
    Write_S6B33B_COM(0x00);
    Write_S6B33B_DISPLAY_DATA_serial_4SPI(0xff);
    for(j=0;j<94;j++)
    {
      Write_S6B33B_DISPLAY_DATA_serial_4SPI(0x80);
    }
    Write_S6B33B_DISPLAY_DATA_serial_4SPI(0xff);

    CS_OP(0);
    Write_S6B33B_COM(0xb8); //set page
      Write_S6B33B_COM(0x10); //set address LSB
    Write_S6B33B_COM(0x00); //set address HSB

    for(j=0;j<96;j++)
    {
      Write_S6B33B_DISPLAY_DATA_serial_4SPI(0x01);
    }
  
}
//***************************************************************************SPI4
void Write_S6B33B_COM(unchar COMDADA_4SPI)
{
  unchar bit8;
  RS_OP(0);
  CS_OP(0);
  for(bit8=0;bit8<8;bit8++)
  {
    SCL_OP(0);
    if((COMDADA_4SPI&0x80)==0x80)
      SDI_OP(1);
    else    
      SDI_OP(0);
    
    SCL_OP(1);
    COMDADA_4SPI=(COMDADA_4SPI<<1);

  }
      
}

void Write_S6B33B_DISPLAY_DATA_serial_4SPI(unchar DADA_4SPI)
{   
  unchar bit8;
  RS_OP(1);
  CS_OP(0);

  for(bit8=0;bit8<8;bit8++)
  {
    SCL_OP(0);
    
    if((DADA_4SPI&0x80)==0x80)
      SDI_OP(1);
    else
      SDI_OP(0);
      
    SCL_OP(1);
    DADA_4SPI=(DADA_4SPI<<1);

  }
}

    
void Delay_ms(unsigned long value)
{
 // unint i,j;
   // for (i=0;i<value;i++)
    //for (j=0;j<500;j++);
    delay(value);
}

void HDReset()
{
  RSTB_OP(0);
  Delay_ms(2);
  RSTB_OP(1);
  Delay_ms(4);
}

#if 0
#define    RSTB_PIN  16
#define    SDI_PIN   23
#define    SCL_PIN   18
#define    CS_PIN    5
#define    REGS_PIN  15
#endif
int pin_list[]={16,23,18,5,15};
 
void setup()
{
  for(int i = 0 ; i < 5; i++)
  {
    pinMode(pin_list[i],OUTPUT);
  }
  Init_S6B33B();
  clear_screen(0x00);
  delay(100);
  //Display_pic1();
  //delay(10000);
  //clear_screen(00);
  display_char();
}

void loop()
{
  //run_lcd();
   
   delay(1000);
   
   //delay(10000);
   
}
#endif
   
