   
//**************************************UC1701 96*49 DOTS *************************
#include "reg51.h"
#include "absacc.h"
#define unchar  unsigned char
#define unint   unsigned int 
//--------------------------------------------------------- 4线SPI接口 驱动
																		  
sbit    RSTB	=P3^4;

sbit    SDI     =P3^7;
sbit	SCL		=P3^6;
sbit    CS0  	=P3^3;
sbit    RS      =P3^5;

sbit    KEY	    =P3^2;

unchar code graphic1[]=
{
0x80,0xF0,0x10,0x10,0xD0,0x40,0x60,0x20,0x20,0x20,0x80,0xC0,0xC0,0x40,0xC0,0xE0,
0xF0,0xF8,0xFE,0x9F,0xCD,0xF5,0xE1,0xF0,0xF8,0xF8,0xFC,0xF4,0xF0,0xF0,0xF8,0xD8,
0xC8,0x40,0x00,0x00,0x00,0x00,0x00,0x80,0x00,0xC0,0xE0,0xF8,0xF0,0xF8,0xFC,0xFE,
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0x7F,0x7F,0x0E,0x1B,0x31,0x60,0x40,0x00,0x00,0x00,0x00,0x00,0x00,0x00,0x00,0x00,
};
void Init_S6B33B();
void Write_S6B33B_COM(unchar COMDADA_4SPI);
void Write_S6B33B_DISPLAY_DATA_serial_4SPI(unchar DADA_4SPI);
void Delay_ms(unsigned long value);
void HDReset();
void Keypress(void);
void clear_screen(unchar xx);
void Display_pic1();
void Display_fangkuang();

void main()
{	
	Init_S6B33B();
	while(1)
	{
//	 clear_screen(0x00);
//	Delay_ms(1000);
	 clear_screen(0xff);
	Delay_ms(1000);
	 clear_screen(0x55);
	Delay_ms(1000);
	 clear_screen(0xaa);
	Delay_ms(1000);
	 clear_screen(0x00);
	 Display_fangkuang();
	 Delay_ms(1000);
	 clear_screen(0x00);
	 Display_pic1();
	 Keypress();
	 }

}

//--------------------------------------------------------------------------

void Init_S6B33B()
{
	HDReset();
	Delay_ms(100);

       Write_S6B33B_COM(0xe2);		 //systen reset

       Write_S6B33B_COM(0x2c);		//set power control 
       Write_S6B33B_COM(0x2e);		//set power control 
       Write_S6B33B_COM(0x2f);		//set power control 
	   	   
       Write_S6B33B_COM(0x25);		//set vlcd registor radio

       Write_S6B33B_COM(0x81);	   //
       Write_S6B33B_COM(0x1a);

       Write_S6B33B_COM(0xa2);
	   	   
       Write_S6B33B_COM(0xc8);		//MY=1

       Write_S6B33B_COM(0xa0);	   //	MX=0

       Write_S6B33B_COM(0xaf);	   //


}


void clear_screen(unchar xx)
{
unchar i,j;
for(i=0;i<9;i++)
	{
		CS0=0;
		Write_S6B33B_COM(0xb0+i);
	    Write_S6B33B_COM(0x10);
		Write_S6B33B_COM(0x00);
		for(j=0;j<132;j++)
		{
			Write_S6B33B_DISPLAY_DATA_serial_4SPI(xx);
		}
	 }
}

void Display_pic1()
{
	unint i,j,adressd=0;

	for(i=0;i<6;i++)
	{
		CS0=0;
		Write_S6B33B_COM(0xb0+i);
	    Write_S6B33B_COM(0x10);
		Write_S6B33B_COM(0x00);
		for(j=0;j<96;j++)
		{
			Write_S6B33B_DISPLAY_DATA_serial_4SPI(graphic1[adressd]);
			adressd++;
		}
	}
} 
void Display_fangkuang()
{
	unint i,j;
	for(i=0;i<5;i++)
	{
		CS0=0;
		Write_S6B33B_COM(0xb0+i);
	    Write_S6B33B_COM(0x10);
		Write_S6B33B_COM(0x00);
		Write_S6B33B_DISPLAY_DATA_serial_4SPI(0xff);
		for(j=0;j<94;j++)
		{
			Write_S6B33B_DISPLAY_DATA_serial_4SPI(0x00);
		}
		Write_S6B33B_DISPLAY_DATA_serial_4SPI(0xff);
	 }

		CS0=0;
		Write_S6B33B_COM(0xb5);
	    Write_S6B33B_COM(0x10);
		Write_S6B33B_COM(0x00);
		Write_S6B33B_DISPLAY_DATA_serial_4SPI(0xff);
		for(j=0;j<94;j++)
		{
			Write_S6B33B_DISPLAY_DATA_serial_4SPI(0x80);
		}
		Write_S6B33B_DISPLAY_DATA_serial_4SPI(0xff);

		CS0=0;
		Write_S6B33B_COM(0xb8);	//set page
	    Write_S6B33B_COM(0x10);	//set address LSB
		Write_S6B33B_COM(0x00);	//set address HSB

		for(j=0;j<96;j++)
		{
			Write_S6B33B_DISPLAY_DATA_serial_4SPI(0x01);
		}
	
}
//***************************************************************************SPI4
void Write_S6B33B_COM(unchar COMDADA_4SPI)
{
	unchar bit8;
	RS=0;
	CS0=0;
	for(bit8=0;bit8<8;bit8++)
	{
		SCL=0;
		if((COMDADA_4SPI&0x80)==0x80)
		SDI=1;
		else		
		SDI=0;
//		SCL=0;
		SCL=1;
		COMDADA_4SPI=(COMDADA_4SPI<<1);

	}
  //  CS1=1;
			
}

void Write_S6B33B_DISPLAY_DATA_serial_4SPI(unchar DADA_4SPI)
{   
	unchar bit8;
	RS=1;
	CS0=0;				

	for(bit8=0;bit8<8;bit8++)
	{
		SCL=0;
		if((DADA_4SPI&0x80)==0x80)
		SDI=1;
		else
		SDI=0;
		SCL=1;
		DADA_4SPI=(DADA_4SPI<<1);

	}
//	CS1=1;
}

		
void Delay_ms(unsigned long value)
{
	unint i,j;
    for (i=0;i<value;i++)
		for (j=0;j<500;j++);
}

void HDReset()
{
	RSTB=0;
	Delay_ms(2);
	RSTB=1;
	Delay_ms(4);
}

void Keypress()
	{
	while(KEY)
	Delay_ms(10);
	}           	